/**
 * @file    nt35510.c
 * @brief   NT35510 LCD 驱动实现 — FSMC 8080 16-bit 接口
 *
 * 指令集采用压缩表驱动: 每条记录 {cmd, data} 或 {sentinel, value}
 *   sentinel=0x0000 → END
 *   sentinel=0xFF00 → DELAY (value=微秒)
 *   sentinel=0xFF01 → CMD_ONLY (value=命令)
 */

#include "nt35510.h"
#include "main.h"
#include <string.h>

/* Sentinel 常量 */
#define NT35510_T_END     0x0000
#define NT35510_T_DELAY   0xFF00
#define NT35510_T_CMD     0xFF01

/* ================================================================
 * 内部辅助函数
 * ================================================================ */

/* 写 16-bit 命令到 CMD 寄存器 */
static inline void nt35510_write_cmd(uint16_t cmd)
{
    NT35510->CMD = cmd;
}

/* 写 16-bit 数据到 DAT 寄存器 */
static inline void nt35510_write_data(uint16_t data)
{
    NT35510->DAT = data;
}

/* us 级延时 (忙等, 仅 init 阶段使用; 168MHz ≈ 6ns/周期) */
static void nt35510_delay_us(uint32_t us)
{
    /* 粗略循环: 168MHz 下 ~168 周期/μs, 每轮 ~4 周期 → ~42 轮/μs */
    volatile uint32_t cnt = us * 42;
    while (cnt--) { __NOP(); }
}

/* ================================================================
 * NT35510 初始化序列
 *
 * 来源: KF56-12 官方驱动 tftlcd.c (TFTLCD_NT35510 分支)
 * 寄存器地址为 16-bit, MIPI DBI Type-C 接口
 * ================================================================ */

static const uint16_t nt35510_init_seq[] = {

    /* --- 0xF0: 页面选择 + 系统复位 --- */
    0xF000, 0x55,
    0xF001, 0xAA,
    0xF002, 0x52,
    0xF003, 0x08,
    0xF004, 0x01,

    /* --- 0xB0: 正极性 Gamma 微调 --- */
    0xB000, 0x0D,
    0xB001, 0x0D,
    0xB002, 0x0D,

    /* --- 0xB6: VCOM 调节 --- */
    0xB600, 0x34,
    0xB601, 0x34,
    0xB602, 0x34,

    /* --- 0xB1: 负极性 Gamma 微调 --- */
    0xB100, 0x0D,
    0xB101, 0x0D,
    0xB102, 0x0D,

    /* --- 0xB7: VCOM 负极性 --- */
    0xB700, 0x34,
    0xB701, 0x34,
    0xB702, 0x34,

    /* --- 0xB2: Gamma 极性选择 --- */
    0xB200, 0x00,
    0xB201, 0x00,
    0xB202, 0x00,

    /* --- 0xB8: 源极输出控制 --- */
    0xB800, 0x24,
    0xB801, 0x24,
    0xB802, 0x24,

    /* --- 0xBF: ESD 保护 --- */
    0xBF00, 0x01,

    /* --- 0xB3: 面板驱动时序 --- */
    0xB300, 0x0F,
    0xB301, 0x0F,
    0xB302, 0x0F,

    /* --- 0xB9: Gate 扫描时序 --- */
    0xB900, 0x34,
    0xB901, 0x34,
    0xB902, 0x34,

    /* --- 0xB5: Gate on Timing --- */
    0xB500, 0x08,
    0xB501, 0x08,
    0xB502, 0x08,

    /* --- 0xC2: VCOM 偏移 --- */
    0xC200, 0x03,

    /* --- 0xBA: 扫描方向 --- */
    0xBA00, 0x24,
    0xBA01, 0x24,
    0xBA02, 0x24,

    /* --- 0xBC: 源极空白 --- */
    0xBC00, 0x00,
    0xBC01, 0x78,
    0xBC02, 0x00,

    /* --- 0xBD: Gate 空白 --- */
    0xBD00, 0x00,
    0xBD01, 0x78,
    0xBD02, 0x00,

    /* --- 0xBE: 面板接口 --- */
    0xBE00, 0x00,
    0xBE01, 0x64,

    /* ============================================================
     * Gamma 校正表 (D1 ~ D6: R/G/B 各两段, 共 6 段 × 52 对)
     * ============================================================ */

    /* --- D1: Gamma R 段 1 (52 对) --- */
    0xD100, 0x00, 0xD101, 0x33, 0xD102, 0x00, 0xD103, 0x34,
    0xD104, 0x00, 0xD105, 0x3A, 0xD106, 0x00, 0xD107, 0x4A,
    0xD108, 0x00, 0xD109, 0x5C, 0xD10A, 0x00, 0xD10B, 0x81,
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    0xD130, 0x03, 0xD131, 0x33, 0xD132, 0x03, 0xD133, 0x6D,

    /* --- D2: Gamma G 段 1 (52 对) --- */
    0xD200, 0x00, 0xD201, 0x33, 0xD202, 0x00, 0xD203, 0x34,
    0xD204, 0x00, 0xD205, 0x3A, 0xD206, 0x00, 0xD207, 0x4A,
    0xD208, 0x00, 0xD209, 0x5C, 0xD20A, 0x00, 0xD20B, 0x81,
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    0xD230, 0x03, 0xD231, 0x33, 0xD232, 0x03, 0xD233, 0x6D,

    /* --- D3: Gamma B 段 1 (52 对) --- */
    0xD300, 0x00, 0xD301, 0x33, 0xD302, 0x00, 0xD303, 0x34,
    0xD304, 0x00, 0xD305, 0x3A, 0xD306, 0x00, 0xD307, 0x4A,
    0xD308, 0x00, 0xD309, 0x5C, 0xD30A, 0x00, 0xD30B, 0x81,
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    0xD330, 0x03, 0xD331, 0x33, 0xD332, 0x03, 0xD333, 0x6D,

    /* --- D4: Gamma 段 2 (52 对) --- */
    0xD400, 0x00, 0xD401, 0x33, 0xD402, 0x00, 0xD403, 0x34,
    0xD404, 0x00, 0xD405, 0x3A, 0xD406, 0x00, 0xD407, 0x4A,
    0xD408, 0x00, 0xD409, 0x5C, 0xD40A, 0x00, 0xD40B, 0x81,
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    0xD430, 0x03, 0xD431, 0x33, 0xD432, 0x03, 0xD433, 0x6D,

    /* --- D5: Gamma 段 3 (52 对) --- */
    0xD500, 0x00, 0xD501, 0x33, 0xD502, 0x00, 0xD503, 0x34,
    0xD504, 0x00, 0xD505, 0x3A, 0xD506, 0x00, 0xD507, 0x4A,
    0xD508, 0x00, 0xD509, 0x5C, 0xD50A, 0x00, 0xD50B, 0x81,
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    0xD530, 0x03, 0xD531, 0x33, 0xD532, 0x03, 0xD533, 0x6D,

    /* --- D6: Gamma 段 4 (52 对) --- */
    0xD600, 0x00, 0xD601, 0x33, 0xD602, 0x00, 0xD603, 0x34,
    0xD604, 0x00, 0xD605, 0x3A, 0xD606, 0x00, 0xD607, 0x4A,
    0xD608, 0x00, 0xD609, 0x5C, 0xD60A, 0x00, 0xD60B, 0x81,
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    0xD630, 0x03, 0xD631, 0x33, 0xD632, 0x03, 0xD633, 0x6D,

    /* --- 页面解锁 + 初始化后配置 --- */
    0xF000, 0x55,
    0xF001, 0xAA,
    0xF002, 0x52,
    0xF003, 0x08,
    0xF004, 0x00,

    /* --- 0xB1: 电源控制 --- */
    0xB100, 0xCC,
    0xB101, 0x00,

    /* --- 0xB6: VCOM 控制 --- */
    0xB600, 0x05,

    /* --- 0xB7: Gate 控制 --- */
    0xB700, 0x70,
    0xB701, 0x70,

    /* --- 0xB8: 源极输出 --- */
    0xB800, 0x01,
    0xB801, 0x03,
    0xB802, 0x03,
    0xB803, 0x03,

    /* --- 0xBC: 源极空白 --- */
    0xBC00, 0x02,
    0xBC01, 0x00,
    0xBC02, 0x00,

    /* --- 0xC9: 内部电源 --- */
    0xC900, 0xD0,
    0xC901, 0x02,
    0xC902, 0x50,
    0xC903, 0x50,
    0xC904, 0x50,

    /* --- 0x35: TE 信号 --- */
    0x3500, 0x00,

    /* --- 0x3A: 16-bit (RGB565) 像素格式 --- */
    0x3A00, 0x55,

    /* --- Sleep Out (仅命令, 无数据) --- */
    NT35510_T_CMD, 0x1100,

    /* --- 等待 120μs 退出 Sleep --- */
    NT35510_T_DELAY, 120,

    /* --- Display On (仅命令, 无数据) --- */
    NT35510_T_CMD, 0x2900,

    /* --- 表结束 --- */
    NT35510_T_END, 0x0000
};

/* ================================================================
 * 内部状态
 * ================================================================ */
static uint8_t  g_dir    = NT35510_DIR_PORTRAIT;
static uint16_t g_width  = NT35510_WIDTH;   /* 当前方向有效宽度 */
static uint16_t g_height = NT35510_HEIGHT;  /* 当前方向有效高度 */

/* ================================================================
 * 公共 API
 * ================================================================ */

/**
 * @brief  执行初始化序列
 * @note   在 FreeRTOS 启动前调用 (HAL_Delay 可用)
 */
void NT35510_Init(void)
{
    uint32_t i;

    /* ===== 软件复位 (SWRESET) =====
     * NT35510 内部 POR 不可靠，必须显式发 0x0100 复位后再等 120ms。
     * 跳过此步骤可能导致寄存器处于不确定状态 → 随机花屏。
     * 参考: 知识库 F407_LCD_NT35510_GT5688芯片信息 第1.5节
     */
    nt35510_write_cmd(0x0100);          /* SWRESET */
    HAL_Delay(120);                     /* 等待复位完成 */

    /* 遍历初始化表 */
    for (i = 0; nt35510_init_seq[i] != NT35510_T_END; i += 2) {
        uint16_t a = nt35510_init_seq[i];
        uint16_t b = nt35510_init_seq[i + 1];

        if (a == NT35510_T_DELAY) {
            nt35510_delay_us(b);
        } else if (a == NT35510_T_CMD) {
            nt35510_write_cmd(b);
        } else {
            /* 常规寄存器写入: cmd → data */
            nt35510_write_cmd(a);
            nt35510_write_data(b);
        }
    }

    /* 设置为默认横屏方向 */
    NT35510_SetDir(NT35510_DIR_LANDSCAPE);
}

/**
 * @brief  设置显示方向
 * @param  dir: NT35510_DIR_PORTRAIT(竖屏480×800) / NT35510_DIR_LANDSCAPE(横屏800×480)
 */
void NT35510_SetDir(uint8_t dir)
{
    g_dir = dir;

    if (dir == NT35510_DIR_PORTRAIT) {
        /* 竖屏: 480×800 — 不交换 XY, 不翻转 */
        nt35510_write_cmd(0x3600);
        nt35510_write_data(0x0000);
        g_width  = NT35510_WIDTH;
        g_height = NT35510_HEIGHT;
    } else {
        /* 横屏正常朝向 0x00A0 (位5=MV,位6=MX,位7=MY)   0x0060=180°旋转 */
        nt35510_write_cmd(0x3600);
        nt35510_write_data(0x00A0);  /* 0x00A0: MV=1 MX=0 MY=0 BGR=0 -- landscape normal */
        g_width  = NT35510_HEIGHT;
        g_height = NT35510_WIDTH;
    }
}

/**
 * @brief  设置绘图窗口 (列/行地址)
 * @note   NT35510 使用拆分寄存器: 0x2A00~0x2A03 (X), 0x2B00~0x2B03 (Y)
 *         参数是逻辑坐标, 由方向决定物理映射
 */
void NT35510_SetWindow(uint16_t sx, uint16_t sy, uint16_t width, uint16_t height)
{
    /* X 范围: 起始→结束 */
    nt35510_write_cmd(0x2A00); nt35510_write_data(sx >> 8);
    nt35510_write_cmd(0x2A01); nt35510_write_data(sx & 0xFF);
    nt35510_write_cmd(0x2A02); nt35510_write_data(width >> 8);
    nt35510_write_cmd(0x2A03); nt35510_write_data(width & 0xFF);

    /* Y 范围: 起始→结束 */
    nt35510_write_cmd(0x2B00); nt35510_write_data(sy >> 8);
    nt35510_write_cmd(0x2B01); nt35510_write_data(sy & 0xFF);
    nt35510_write_cmd(0x2B02); nt35510_write_data(height >> 8);
    nt35510_write_cmd(0x2B03); nt35510_write_data(height & 0xFF);

    /* 内存写入命令 — 后续写 DAT 即为像素数据 */
    nt35510_write_cmd(0x2C00);
}

/**
 * @brief  快速写像素 (SetWindow 后连续调用来逐点填充)
 * @param  color: RGB565 颜色值
 */
void NT35510_WritePixel(uint16_t color)
{
    NT35510->DAT = color;
}

/**
 * @brief  画单个点 (含窗口设置)
 * @param  x, y: 逻辑坐标
 * @param  color: RGB565 颜色值
 */
void NT35510_DrawPixel(uint16_t x, uint16_t y, uint16_t color)
{
    NT35510_SetWindow(x, y, x, y);
    NT35510->DAT = color;
}

/**
 * @brief  读像素值 (调色/触摸反馈用)
 * @param  x, y: 逻辑坐标
 * @return RGB565 像素值
 */
uint16_t NT35510_ReadPixel(uint16_t x, uint16_t y)
{
    uint16_t r, g, b;

    NT35510_SetWindow(x, y, x, y);

    /* 0x2E00: 读内存命令 */
    nt35510_write_cmd(0x2E00);

    /* 第一次读是 dummy, 丢弃 */
    r = NT35510->DAT;

    /* 第二次读: R(高8位) + G(高8位) */
    r = NT35510->DAT;

    /* 第三次读: B(高8位) + 填充 */
    b = NT35510->DAT;

    /* 重组 RGB888 → RGB565 */
    g = r & 0x00FF;     /* G 在第一次读的低 8 位 */
    g <<= 8;
    r = r >> 11;        /* R 高 5 位 → bit[4:0] */
    g = g >> 10;        /* G 高 6 位 → bit[10:5] */
    b = b >> 11;        /* B 高 5 位 → bit[4:0] */

    return (r << 11) | (g << 5) | b;
}

/**
 * @brief  清屏 — 全屏填充单色
 * @param  color: RGB565 颜色值
 */
void NT35510_Clear(uint16_t color)
{
    /* 用 SetWindow 覆盖全屏, 然后连续写点 */
    NT35510_SetWindow(0, 0, g_width - 1, g_height - 1);

    uint32_t total = (uint32_t)g_width * g_height;
    for (uint32_t i = 0; i < total; i++) {
        NT35510->DAT = color;
    }
}

/**
 * @brief  矩形填充
 * @param  sx, sy: 左上角坐标
 * @param  ex, ey: 右下角坐标
 * @param  color: RGB565 颜色值
 */
void NT35510_Fill(uint16_t sx, uint16_t sy, uint16_t ex, uint16_t ey, uint16_t color)
{
    uint16_t w = ex - sx + 1;
    uint16_t h = ey - sy + 1;
    uint32_t total = (uint32_t)w * h;

    NT35510_SetWindow(sx, sy, ex, ey);

    for (uint32_t i = 0; i < total; i++) {
        NT35510->DAT = color;
    }
}

/**
 * @brief  获取当前方向有效宽度
 */
uint16_t NT35510_GetWidth(void)
{
    return g_width;
}

/**
 * @brief  获取当前方向有效高度
 */
uint16_t NT35510_GetHeight(void)
{
    return g_height;
}
