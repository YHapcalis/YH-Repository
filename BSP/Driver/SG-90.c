/* ================================================================
 * 文件：SG-90.c — 舵机控制模块（指数平滑版本）
 *
 * 🎯 功能：控制 SG-90 微型舵机的角度（-40° ~ +40° 相对转向）
 *
 * ⚙️ 硬件连接：
 *   SG-90 有 3 根线：
 *     红线（VCC） → 5V
 *     棕线（GND） → GND
 *     橙线（信号）→ PF7（TIM11_CH1 PWM 输出）
 *
 * 🧠 舵机控制原理：
 *   舵机通过 PWM（脉冲宽度调制）控制角度。
 *   SG-90 要求的 PWM 周期 = 20ms（50Hz）。
 *   PWM 的高电平时间（脉宽）决定角度：
 *     0.5ms  → 0°
 *     1.0ms  → 45°
 *     1.5ms  → 90°（正中）
 *     2.0ms  → 135°
 *     2.5ms  → 180°
 *   也就是脉宽每增加 1ms，角度增加 90°。
 *
 * 🔧 定时器配置（F407）：
 *   TIM11：PWM 输出模式
 *         PSC = 83-1 → 84MHz / 84 = 1MHz（计数频率）
 *         ARR = 9999-1 → 1MHz / 10000 = 100Hz 周期
 *         比较值（CCR）：500~2500 对应 0.5ms~2.5ms
 *         CH1 对应 PF7 引脚
 *
 * 🤔 为什么叫"指数平滑"？
 *   传统控制：角度直接从 A 跳到 B（"啪"一下过去）
 *   指数平滑：每次只"靠近"目标一点点，而且越靠近速度越慢
 *   公式：当前值 = 当前值 × (1-α) + 目标值 × α
 *         α = 0.3（平滑系数）
 *
 *   比如从 0° 到 90°：每次更新（10~20ms 一次）：
 *     第1次：0×0.7 + 90×0.3 = 27°  （快速起步）
 *     第2次：27×0.7 + 90×0.3 = 45.9°（减速）
 *     第3次：45.9×0.7 + 90×0.3 = 59.1°（继续减速）
 *     ...逐渐接近 90°但永远不会突然跳到 90°
 *   这样舵机转向看起来就很"顺滑"，不会"咔咔"作响。
 * ================================================================ */

/*
 * 📚 包含头文件
 */
#include "SG-90.h"    // 本模块头文件
#include "tim.h"      // 定时器句柄 htim11 的声明

/*
 * 🔢 比较值（CCR）常量
 * TIM11 时钟 = 1MHz（1 计数 = 1μs）
 * ARR = 9999（10000 个计数，对应 10ms）
 * 所以：
 *   500   × 1μs = 0.5ms → 0°
 *   1500  × 1μs = 1.5ms → 90°（正中）
 *   2500  × 1μs = 2.5ms → 180°
 */
#define SG90_MIN_CMP 500U   // 最小比较值（0°）
#define SG90_MID_CMP 1500U  // 中间比较值（90°）
#define SG90_MAX_CMP 2500U  // 最大比较值（180°）

/*
 * 相对角度限幅
 * rel_angle 表示"相对于正前方的偏转角度"
 * 正数 = 右转，负数 = 左转
 * 范围 -40~+40（单位：°）
 */
#define SG90_MIN_REL_ANGLE (-90)  // 最小相对角度（左转 90°）
#define SG90_MAX_REL_ANGLE 90     // 最大相对角度（右转 90°）

/*
 * 🎯 指数平滑系数（Smoothing Factor）
 *   范围：0.0 ~ 1.0
 *   越大 → 响应越快（但动作会变"生硬"）
 *   越小 → 动作越柔（但转向会变"迟钝"）
 *   经验值 0.3 是比较好的平衡点
 */
#define SMOOTH_FACTOR 0.3f

/*
 * 当前浮点角度（带小数，便于平滑过渡）
 * 绝对角度：0°（左极限）~ 180°（右极限）
 * 初始值 90.0 = 正中央
 */
static float current_angle_float = 90.0f;

/*
 * 目标相对角度（-40 ~ +40）
 * 由 SG90_SetAngle() 设置，由 SG90_Update() 执行
 * 这个角度是"相对值"，换算成绝对值 = 90 + rel_angle
 */
static int8_t target_rel_angle = 0;

/*
 * ================================================================
 * 函数：SG90_Init — 舵机初始化
 * ================================================================
 *
 * 做了两件事：
 *   1. 启动 TIM4_CH3 的 PWM 输出
 *   2. 设置初始角度为 90°（正中位置）
 *   3. 初始化内部变量
 */
void SG90_Init(void)
{
    HAL_TIM_PWM_Start(&htim11, TIM_CHANNEL_1);

    /* 初始位置：90°（正中） */
    __HAL_TIM_SET_COMPARE(&htim11, TIM_CHANNEL_1, SG90_MID_CMP);

    /* 内部变量初始化 */
    current_angle_float = 90.0f;  // 当前角度 = 90°
    target_rel_angle = 0;          // 目标相对角度 = 0°（正中）
}

/*
 * ================================================================
 * 函数：SG90_SetAngle — 设置目标偏转角度
 * ================================================================
 *
 * 这个函数只是"记录目标值"，不立即执行。
 * 真正的执行是在 SG90_Update() 中完成的。
 * 这就是"异步设置"——告诉舵机"你慢慢转到这个角度"。
 *
 * 参数：
 *   rel_angle — 相对角度（-40 ~ +40）
 *     负数 = 左转，正数 = 右转，0 = 正中
 *
 * 限幅保护：
 *   如果传入的角度超出 -40~+40 的范围，自动截断到边界值。
 *   防止舵机撞到机械限位（会卡住甚至烧毁）。
 */
void SG90_SetAngle(int8_t rel_angle)
{
    /* 上限保护：不能超过 +40° */
    if (rel_angle > SG90_MAX_REL_ANGLE)
    {
        rel_angle = SG90_MAX_REL_ANGLE;
    }
    /* 下限保护：不能低于 -40° */
    if (rel_angle < SG90_MIN_REL_ANGLE)
    {
        rel_angle = SG90_MIN_REL_ANGLE;
    }

    /* 记录目标角度 */
    target_rel_angle = rel_angle;
}

/*
 * ================================================================
 * 函数：SG90_Update — 执行舵机角度更新（指数平滑）
 * ================================================================
 *
 * 这个函数需要每隔 10~20ms 调用一次（由 app_run 调度）。
 *
 * 📋 执行步骤：
 *   1. 计算目标绝对角度 = 90° + target_rel_angle
 *   2. 指数平滑：current = current × 0.7 + target × 0.3
 *   3. 四舍五入得到整数角度
 *   4. 限幅 0~180°
 *   5. 换算成比较值（CCR）：50 + (角度 × 200 ÷ 180)
 *   6. 限幅 50~250
 *   7. 写入 TIM4 比较寄存器
 *
 *   流程图：
 *   目标角度 → 指数平滑 → 四舍五入 → 限幅 → 换算CCR → 写寄存器
 */
void SG90_Update(void)
{
    /*
     * Step 1：计算目标绝对角度
     * 比如 target_rel_angle = +35（右转 35°）
     *   target_abs = 90 + 35 = 125°
     * 角度范围：50°(90-40) ~ 130°(90+40)
     */
    float target_abs = 90.0f + (float)target_rel_angle;

    /*
     * Step 2：指数平滑
     *
     * 公式拆解：
     *   current_angle_float × (1 - 0.3) = current × 0.7 → "保持"的部分
     *   target_abs × 0.3 → "靠近目标"的部分
     *
     * 两部分加起来 = new_current
     *
     * 类比理解：
     *   你在追一辆车（目标），每次你移动当前距离的 70% 加上目标距离的 30%。
     *   一开始离得远，你跑得快（因为目标部分占比大）；
     *   快追上了，你跑得慢（因为当前部分占比大）。
     *   最后你会无限接近目标，但永远不突然"瞬移"。
     */
    current_angle_float = current_angle_float * (1.0f - SMOOTH_FACTOR)
                         + target_abs * SMOOTH_FACTOR;

    /*
     * Step 3：浮点数四舍五入为整数
     * +0.5f 然后取整 = 四舍五入
     * 比如 87.3 + 0.5 = 87.8 → (int) = 87（舍去）
     * 比如 87.7 + 0.5 = 88.2 → (int) = 88（进位）
     */
    int32_t angle_i32 = (int32_t)(current_angle_float + 0.5f);

    /* Step 4：限幅 0~180°（硬件安全保护） */
    if (angle_i32 < 0)
    {
        angle_i32 = 0;  // 不能低于 0°
    }
    if (angle_i32 > 180)
    {
        angle_i32 = 180;  // 不能超过 180°
    }

    /*
     * Step 5：角度 → 比较值（CCR）换算
     *
     * 公式推导：
     *   0°   → 比较值 50（0.5ms）
     *   180° → 比较值 250（2.5ms）
     *   差值 = 250 - 50 = 200 个计数
     *   所以每度对应 200/180 个计数
     *
     * 例：角度 = 125°
     *   cmp = 50 + 125 × 200 ÷ 180
     *       = 50 + 138.9
     *       = 188（四舍五入后）
     *   脉宽 = 188 × 10us = 1.88ms
     *   对应角度 ≈ 1.88ms × 90°/ms - 45° ≈ 124°
     */
    uint32_t cmp = SG90_MIN_CMP + ((uint32_t)angle_i32 * 2000U) / 180U;

    /* Step 6：比较值限幅 50~250 */
    if (cmp < SG90_MIN_CMP)
    {
        cmp = SG90_MIN_CMP;
    }
    if (cmp > SG90_MAX_CMP)
    {
        cmp = SG90_MAX_CMP;
    }

    /*
     * Step 7：写入比较寄存器
     * __HAL_TIM_SET_COMPARE 会直接修改 TIM4 的 CCR3 寄存器。
     * TIM4 的硬件会自动比较 CNT 和 CCR3，
     * 当 CNT < CCR3 时，PB8 输出高电平；
     * 当 CNT >= CCR3 时，PB8 输出低电平。
     * 从而产生指定脉宽的 PWM 信号。
     */
    __HAL_TIM_SET_COMPARE(&htim11, TIM_CHANNEL_1, cmp);
}

/*
 * ================================================================
 * 函数：SG90_SetPulse — 直接设置脉宽（调试用）
 * ================================================================
 *
 * 这个函数绕过角度换算，直接写入比较值。
 * 主要用于调试和校准——可以直接验证舵机的脉冲响应。
 *
 * 参数：
 *   pulse — 定时器比较值（50~250）
 *     50  = 0.5ms  = 0°
 *     100 = 1.0ms  = 45°
 *     150 = 1.5ms  = 90°
 *     200 = 2.0ms  = 135°
 *     250 = 2.5ms  = 180°
 */
void SG90_SetPulse(uint32_t pulse)
{
    /* 限幅保护 */
    if (pulse < SG90_MIN_CMP)
    {
        pulse = SG90_MIN_CMP;
    }
    if (pulse > SG90_MAX_CMP)
    {
        pulse = SG90_MAX_CMP;
    }

    /* 直接写入比较寄存器 */
    __HAL_TIM_SET_COMPARE(&htim11, TIM_CHANNEL_1, pulse);
}